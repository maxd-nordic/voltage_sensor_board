## boards/arm/voltage_sensor/Kconfig.defconfig
```kconfig
# Copyright (c) 2021 Nordic Semiconductor ASA
# SPDX-License-Identifier: Apache-2.0

if BOARD_VOLTAGE_SENSOR

config BOARD
	default "voltage_sensor"

endif # BOARD_VOLTAGE_SENSOR
```
